ENTRY(Reset_Handler)

MEMORY
{
  FLASH (rx) : ORIGIN = 0x08000000, LENGTH = 256K
  EEPROM (rw): ORIGIN = 0x08080000, LENGTH = 8K
  RAM  (xrw) : ORIGIN = 0x20000000, LENGTH = 32K
}

_estack = 0x20008000;
